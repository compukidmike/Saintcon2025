## Firmware/attract_player/sdkconfig.defaults
```kconfig
CONFIG_IDF_TARGET="esp32s3"
CONFIG_ESPTOOLPY_FLASHMODE_QIO=y
CONFIG_ESPTOOLPY_FLASHFREQ_120M=y
CONFIG_ESPTOOLPY_FLASHSIZE_16MB=y
CONFIG_PARTITION_TABLE_CUSTOM=y
CONFIG_PARTITION_TABLE_CUSTOM_FILENAME="partitions.csv"
CONFIG_SPIRAM=y
CONFIG_SPIRAM_MODE_QUAD=y
CONFIG_SPIRAM_SPEED_120M=y
CONFIG_SPIRAM_USE_MALLOC=y
CONFIG_SPIRAM_TRY_ALLOCATE_WIFI_LWIP=y
CONFIG_ESP_MAIN_TASK_STACK_SIZE=8192
CONFIG_FREERTOS_HZ=1000
```

## Firmware/badge/components/battery/Kconfig
```kconfig
menu "Battery"

    config BATTERY_SENSE_GPIO
        int "Battery Sense GPIO"
        default -1
        range -1 20
        help
            GPIO pin used for battery sensing. This should be connected to a voltage divider that scales the battery voltage to a safe level for the ESP32 ADC. On the ESP32-S3 the ADC pins are GPIO's 1-20.

endmenu
```

## Firmware/badge/components/dawn_accord/Kconfig
```kconfig
menu "Dawn Accord"

    config AI_INHIBITOR_GPIO
        int "AI Inhibitor GPIO"
        default -1
        range -1 20
        help
            GPIO pin used for AI Inhibitor. Connected through a resistor to GND... resistance value will be estimated somewhat via the ADC.

    config AI_SECURITY_STRIP_GPIO
        int "AI Security Strip GPIO"
        default -1
        range -1 20
        help
            GPIO pin used for AI Security Strip. Connected to GND when the security strip is in place. Open once the trace is cut.

endmenu
```

## Firmware/badge/components/display/Kconfig
```kconfig
menu "Display"

    choice LCD_CONTROLLER_DRIVER
        prompt "LCD Controller Driver"
        default LCD_CONTROLLER_ST7789
        help
            Select the LCD controller driver to use. There may be an LVGL supported version or a native version listed here

        config LCD_CONTROLLER_ST7789
            bool "ST7789"
            help
                ST7789 LCD controller driver (ESP-IDF native)

        config LCD_CONTROLLER_ST7789_LVGL
            bool "ST7789 (LVGL)"
            depends on LV_USE_ST7789
            help
                ST7789 LCD controller driver (LVGL)
    endchoice

    choice LCD_I80_BUS_WIDTH
        prompt "I80 Bus Width"
        default LCD_I80_BUS_WIDTH_8
        help
            Select the I80 bus width to use. This is the number of data lines used to communicate with the LCD controller

        config LCD_I80_BUS_WIDTH_8
            bool "8-bit"
            help
                8-bit I80 bus width

        config LCD_I80_BUS_WIDTH_16
            bool "16-bit"
            help
                16-bit I80 bus width
    endchoice

    menu "Display GPIOs"
        config LCD_I80_DATA_0_GPIO
            int "Data 0"
            default 0
            range 0 SOC_GPIO_PIN_COUNT
            help
                GPIO pin number for I80 data 0

        config LCD_I80_DATA_1_GPIO
            int "Data 1"
            default 0
            range 0 SOC_GPIO_PIN_COUNT
            help
                GPIO pin number for I80 data 1

        config LCD_I80_DATA_2_GPIO
            int "Data 2"
            default 0
            range 0 SOC_GPIO_PIN_COUNT
            help
                GPIO pin number for I80 data 2

        config LCD_I80_DATA_3_GPIO
            int "Data 3"
            default 0
            range 0 SOC_GPIO_PIN_COUNT
            help
                GPIO pin number for I80 data 3

        config LCD_I80_DATA_4_GPIO
            int "Data 4"
            default 0
            range 0 SOC_GPIO_PIN_COUNT
            help
                GPIO pin number for I80 data 4

        config LCD_I80_DATA_5_GPIO
            int "Data 5"
            default 0
            range 0 SOC_GPIO_PIN_COUNT
            help
                GPIO pin number for I80 data 5

        config LCD_I80_DATA_6_GPIO
            int "Data 6"
            default 0
            range 0 SOC_GPIO_PIN_COUNT
            help
                GPIO pin number for I80 data 6

        config LCD_I80_DATA_7_GPIO
            int "Data 7"
            default 0
            range 0 SOC_GPIO_PIN_COUNT
            help
                GPIO pin number for I80 data 7

        config LCD_I80_DATA_8_GPIO
            int "Data 8"
            default 0
            range 0 SOC_GPIO_PIN_COUNT
            depends on LCD_I80_BUS_WIDTH_16
            help
                GPIO pin number for I80 data 8

        config LCD_I80_DATA_9_GPIO
            int "Data 9"
            default 0
            range 0 SOC_GPIO_PIN_COUNT
            depends on LCD_I80_BUS_WIDTH_16
            help
                GPIO pin number for I80 data 9

        config LCD_I80_DATA_10_GPIO
            int "Data 10"
            default 0
            range 0 SOC_GPIO_PIN_COUNT
            depends on LCD_I80_BUS_WIDTH_16
            help
                GPIO pin number for I80 data 10

        config LCD_I80_DATA_11_GPIO
            int "Data 11"
            default 0
            range 0 SOC_GPIO_PIN_COUNT
            depends on LCD_I80_BUS_WIDTH_16
            help
                GPIO pin number for I80 data 11

        config LCD_I80_DATA_12_GPIO
            int "Data 12"
            default 0
            range 0 SOC_GPIO_PIN_COUNT
            depends on LCD_I80_BUS_WIDTH_16
            help
                GPIO pin number for I80 data 12

        config LCD_I80_DATA_13_GPIO
            int "Data 13"
            default 0
            range 0 SOC_GPIO_PIN_COUNT
            depends on LCD_I80_BUS_WIDTH_16
            help
                GPIO pin number for I80 data 13

        config LCD_I80_DATA_14_GPIO
            int "Data 14"
            default 0
            range 0 SOC_GPIO_PIN_COUNT
            depends on LCD_I80_BUS_WIDTH_16
            help
                GPIO pin number for I80 data 14

        config LCD_I80_DATA_15_GPIO
            int "Data 15"
            default 0
            range 0 SOC_GPIO_PIN_COUNT
            depends on LCD_I80_BUS_WIDTH_16
            help
                GPIO pin number for I80 data 15

        config LCD_I80_RS_GPIO
            int "Register Select [RS/DC]"
            default 0
            range 0 SOC_GPIO_PIN_COUNT
            help
                GPIO pin number for I80 register select. Sometimes also labeled DC

        config LCD_I80_CS_GPIO
            int "Chip Select [CS]"
            default 0
            range 0 SOC_GPIO_PIN_COUNT
            help
                GPIO pin number for I80 chip select

        config LCD_I80_TE_GPIO
            int "Tearing Effect [TE] (-1 if unused)"
            default -1
            range -1 SOC_GPIO_PIN_COUNT
            help
                GPIO pin number for I80 tearing effect (TE) signal - some displays expose this pin for syncing MCU to frame memory

        config LCD_I80_RD_GPIO
            int "Read [RD] (-1 if unused)"
            default -1
            range -1 SOC_GPIO_PIN_COUNT
            help
                GPIO pin number for I80 read

        config LCD_I80_WR_GPIO
            int "Write [WR/CLK/PCLK]"
            default 0
            range 0 SOC_GPIO_PIN_COUNT
            help
                GPIO pin number for I80 write. Sometimes also labeled CLK, or PCLK

        config LCD_I80_RESET_GPIO
            int "Reset [RST]"
            default 0
            range 0 SOC_GPIO_PIN_COUNT
            help
                GPIO pin number for I80 reset
    endmenu

    config LCD_WIDTH
        int "Display Width"
        default 240
        range 0 4096
        help
            Display width in pixels

    config LCD_HEIGHT
        int "Display Height"
        default 320
        range 0 4096
        help
            Display height in pixels

    choice LCD_DEFAULT_ORIENTATION
        prompt "Default display orientation"
        default LCD_ORIENTATION_LANDSCAPE
        help
            Select the display orientation

        config LCD_ORIENTATION_LANDSCAPE
            bool "Landscape"
            help
                Landscape orientation

        config LCD_ORIENTATION_LANDSCAPE_FLIP
            bool "Landscape (Flipped)"
            help
                Landscape (flipped) orientation

        config LCD_ORIENTATION_PORTRAIT
            bool "Portrait"
            help
                Portrait orientation

        config LCD_ORIENTATION_PORTRAIT_FLIP
            bool "Portrait (Flipped)"
            help
                Portrait (flipped) orientation
    endchoice

    choice LCD_BACKLIGHT_CONTROL
        prompt "Backlight Control"
        default LCD_BACKLIGHT_CONTROL_SIMPLE
        help
            Select the backlight control method

        config LCD_BACKLIGHT_CONTROL_SIMPLE
            bool "Simple [on/off]"
            help
                Basic on/off backlight control

        config LCD_BACKLIGHT_CONTROL_PWM
            bool "Adjustable [PWM]"
            help
                PWM backlight control
    endchoice

    config LCD_BACKLIGHT_GPIO
        int "Backlight GPIO"
        default 0
        range 0 SOC_GPIO_PIN_COUNT
        help
            GPIO pin number for the backlight

    config LCD_I80_COLOR_IN_PSRAM
        bool "Color Buffer in PSRAM"
        default n
        help
            Store the color buffer in PSRAM

    config LCD_SWAP_COLOR_BYTES
        bool "Swap Color Bytes"
        default n
        help
            Swap the color bytes for the display

    choice LCD_SWAP_COLOR_BYTES_IMPL
        prompt "Color Swap Implementation"
        default LCD_SWAP_COLOR_DMA
        depends on LCD_SWAP_COLOR_BYTES
        help
            Select the implementation to use for swapping color bytes

        config LCD_SWAP_COLOR_DMA
            bool "DMA"
            help
                Swap color bytes in DMA (fastest)

        config LCD_SWAP_COLOR_LVGL
            bool "LVGL"
            help
                Use LVGL function calls for swapping color bytes
    endchoice

endmenu
```

## Firmware/badge/components/minibadge/Kconfig
```kconfig
menu "Minibadge Configuration"

    config MINIBADGE_ENABLED
        bool "Enable Minibadge"
        default n
        help
            Enable support for the Minibadge features.

    config MINIBADGE_CLOCK_LOW_PIN
        int "Clock Pin (Low)"
        depends on MINIBADGE_ENABLED
        default -1
        range -1 SOC_GPIO_PIN_COUNT
        help
            GPIO pin number for the minibadge on/off blinky clock - low.

    config MINIBADGE_CLOCK_HIGH_PIN
        int "Clock Pin (High)"
        depends on MINIBADGE_ENABLED
        default -1
        range -1 SOC_GPIO_PIN_COUNT
        help
            GPIO pin number for the minibadge on/off blinky clock - high.

endmenu
```

## Firmware/badge/components/nfc/Kconfig
```kconfig
menu "NFC Configuration"
    config NFC_GPO_PIN
        int "NFC GPO Pin"
        default -1
        range -1 SOC_GPIO_PIN_COUNT
        help
            The GPIO pin used for NFC GPO (General Purpose Output).
            Set to -1 to disable.
endmenu
```

## Firmware/badge/main/Kconfig.projbuild
```kconfig
menu "Badge Configuration"

    # Device type configuration menu
    menu "Device Configuration"
        choice DEVICE_TYPE
            prompt "Device Type"
            default DEVICE_TYPE_BADGE
            help
                Select the type of device this firmware will run on.

            config DEVICE_TYPE_BADGE
                bool "Badge"
                help
                    Build firmware for Badge device.

            config DEVICE_TYPE_NUT
                bool "Nut"
                help
                    Build firmware for Nut device.
        endchoice
    endmenu

    # ----------------------------------------------------------------
    # Shared component configuration menus
    # ----------------------------------------------------------------

    # I2C configuration menu
    rsource "../shared_components/i2c_manager/Kconfig"

    # LED configuration menu
    rsource "../shared_components/led/Kconfig"

    # Security chip configuration menu
    rsource "../shared_components/secure_element/Kconfig"

    # WiFi configuration menu
    rsource "../shared_components/wifi_manager/Kconfig"

    # ----------------------------------------------------------------
    # Badge-specific component configuration menus
    # ----------------------------------------------------------------

    # Battery configuration menu
    rsource "../components/battery/Kconfig"

    # Dawn Accord configuration menu
    rsource "../components/dawn_accord/Kconfig"

    # Display configuration menu
    rsource "../components/display/Kconfig"

    # Input configuration menu
    rsource "../components/input/Kconfig"

    # Minibadge configuration menu
    rsource "../components/minibadge/Kconfig"

    # NFC configuration menu
    rsource "../components/nfc/Kconfig"

endmenu
```

## Firmware/badge/shared_components/led/Kconfig
```kconfig
menu "LED Strip"

    config LED_GPIO
        int "LED Strip GPIO Pin"
        range 0 48
        default 10
        help
          GPIO pin connected to the LED strip data line.

    config LED_NUM_LEDS
        int "Number of LEDs in strip"
        range 1 300
        default 20
        help
          The number of LEDs in the LED strip.

    choice LED_STRIP_MODEL
        prompt "LED Strip Model"
        default LED_STRIP_MODEL_WS2812
        help
          Select the LED strip model.

        config LED_STRIP_MODEL_WS2812
            bool "WS2812/WS2812B"
            help
              WS2812 or WS2812B LED strip.

        config LED_STRIP_MODEL_SK6812
            bool "SK6812"
            help
              SK6812 LED strip.

        config LED_STRIP_MODEL_WS2811
            bool "WS2811"
            help
              WS2811 LED strip.
    endchoice

    choice LED_COLOR_FORMAT
        prompt "LED Color Component Format"
        default LED_COLOR_FORMAT_GRB
        help
          Select the color component format for the LED strip.

        config LED_COLOR_FORMAT_GRB
            bool "GRB (Green-Red-Blue)"
            help
              Green-Red-Blue color format (most common for WS2812).

        config LED_COLOR_FORMAT_RGB
            bool "RGB (Red-Green-Blue)"
            help
              Red-Green-Blue color format.

        config LED_COLOR_FORMAT_BGR
            bool "BGR (Blue-Green-Red)"
            help
              Blue-Green-Red color format.
    endchoice

    config LED_GAMMA_CORRECTION
        bool "Enable gamma correction"
        default y
        help
          Enable gamma correction for better color accuracy.

endmenu
```

## Firmware/badge/shared_components/secure_element/Kconfig
```kconfig
menu "Secure Element"

    config SECURE_ELEMENT_ENABLED
        bool "Enable ATECC608B Secure Element"
        default n
        help
            Enable support for secure element functionality.

endmenu
```
