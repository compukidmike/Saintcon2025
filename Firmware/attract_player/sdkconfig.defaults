## Firmware/nut/components/input/Kconfig
```kconfig
menu "Input"

    config INPUT_TOUCH_ENABLED
        bool "Touch Enabled"
        default n
        help
            Enable touch support for the display

    if INPUT_TOUCH_ENABLED
        choice INPUT_TOUCH_CONTROLLER
            prompt "Touch Controller"
            default INPUT_TOUCH_CONTROLLER_GT911
            depends on INPUT_TOUCH_ENABLED
            help
                Select the touch controller to use

            config INPUT_TOUCH_CONTROLLER_GT911
                bool "GT911"
                help
                    GT911 touch controller. Make sure you install the esp_lcd_touch_gt911 component
        endchoice

        menu "Touch GPIOs"
            config INPUT_TOUCH_SDA_GPIO
                int "SDA"
                default 0
                range 0 SOC_GPIO_PIN_COUNT
                depends on INPUT_TOUCH_ENABLED
                help
                    GPIO pin number for the touch SDA

            config INPUT_TOUCH_SCL_GPIO
                int "SCL"
                default 0
                range 0 SOC_GPIO_PIN_COUNT
                depends on INPUT_TOUCH_ENABLED
                help
                    GPIO pin number for the touch SCL

            config INPUT_TOUCH_USE_INTERRUPT
                bool "Enable interrupt for touch input rather than polling"
                default n
                depends on INPUT_TOUCH_ENABLED
                help
                    Use touch interrupt

            config INPUT_TOUCH_INT_GPIO
                int "Interrupt [INT]"
                default 0
                range 0 SOC_GPIO_PIN_COUNT
                depends on INPUT_TOUCH_ENABLED && INPUT_TOUCH_USE_INTERRUPT
                help
                    GPIO pin number for INT

            config INPUT_TOUCH_USE_RST
                bool "Enable reset pin"
                default n
                depends on INPUT_TOUCH_ENABLED
                help
                    Use touch reset

            config INPUT_TOUCH_RST_GPIO
                int "Reset [RST]"
                default 0
                range 0 SOC_GPIO_PIN_COUNT
                depends on INPUT_TOUCH_ENABLED && INPUT_TOUCH_USE_RST
                help
                    GPIO pin number for RST
        endmenu

        config INPUT_TOUCH_DEBOUNCE_MS
            int "Touch Debounce Time (ms)"
            default 30
            range 0 1000
            depends on INPUT_TOUCH_ENABLED
            help
                Touch debounce time in milliseconds
    endif

  config INPUT_JOYSTICK_ENABLED
    bool "Enable joystick input"
    default n
    help
        Enable joystick input support

  if INPUT_JOYSTICK_ENABLED
    config INPUT_JOY_UP_GPIO
      int "Up GPIO"
      range 0 SOC_GPIO_PIN_COUNT
      default -1
    config INPUT_JOY_DOWN_GPIO
      int "Down GPIO"
      range 0 SOC_GPIO_PIN_COUNT
      default -1
    config INPUT_JOY_LEFT_GPIO
      int "Left GPIO"
      range 0 SOC_GPIO_PIN_COUNT
      default -1
    config INPUT_JOY_RIGHT_GPIO
      int "Right GPIO"
      range 0 SOC_GPIO_PIN_COUNT
      default -1
    config INPUT_JOY_CENTER_GPIO
      int "Center GPIO"
      range 0 SOC_GPIO_PIN_COUNT
      default -1
  endif

endmenu
```

## Firmware/nut/main/Kconfig.projbuild
```kconfig
menu "Nut Configuration"

    # Device type configuration menu
    menu "Device Configuration"
        choice DEVICE_TYPE
            prompt "Device Type"
            default DEVICE_TYPE_BADGE
            help
                Select the type of device this firmware will run on.

            config DEVICE_TYPE_BADGE
                bool "Badge"
                help
                    Build firmware for Badge device.

            config DEVICE_TYPE_NUT
                bool "Nut"
                help
                    Build firmware for Nut device.
        endchoice
    endmenu

    # ----------------------------------------------------------------
    # Shared component configuration menus
    # ----------------------------------------------------------------

    # I2C configuration menu
    rsource "../shared_components/i2c_manager/Kconfig"

    # Security configuration menu
    rsource "../shared_components/secure_element/Kconfig"

    # WiFi configuration menu
    rsource "../shared_components/wifi_manager/Kconfig"

    # LED configuration menu
    rsource "../shared_components/led/Kconfig"

endmenu
```

## Firmware/nut/shared_components/i2c_manager/Kconfig
```kconfig
menu "I2C Manager"

config I2C_MANAGER_BUS_A_ENABLE
    bool "Enable I2C Bus A (port 0)"
    default y
config I2C_MANAGER_BUS_A_SDA_GPIO
    int "Bus A SDA GPIO" if I2C_MANAGER_BUS_A_ENABLE
    default 0
    range 0 SOC_GPIO_PIN_COUNT
config I2C_MANAGER_BUS_A_SCL_GPIO
    int "Bus A SCL GPIO" if I2C_MANAGER_BUS_A_ENABLE
    default 0
    range 0 SOC_GPIO_PIN_COUNT

choice I2C_MANAGER_BUS_A_MUX
    prompt "Bus A Mux Type" if I2C_MANAGER_BUS_A_ENABLE
    default I2C_MANAGER_BUS_A_MUX_NONE
    config I2C_MANAGER_BUS_A_MUX_NONE
        bool "None"
    config I2C_MANAGER_BUS_A_MUX_TCA9544A
        bool "TCA9544A (4-channel)"
    config I2C_MANAGER_BUS_A_MUX_PCA9548A
        bool "PCA9548A (8-channel)"
endchoice

config I2C_MANAGER_BUS_A_MUX_ADDRESS
    hex "Bus A mux I2C address" if I2C_MANAGER_BUS_A_ENABLE && !I2C_MANAGER_BUS_A_MUX_NONE
    default 0x70
    range 0x03 0x77

config I2C_MANAGER_BUS_A_MUX_INT_ENABLE
    bool "Enable Bus A mux INT pin" if I2C_MANAGER_BUS_A_ENABLE && I2C_MANAGER_BUS_A_MUX_TCA9544A
    default n
    help
        Enable interrupt aggregation support for TCA9544A on Bus A. Provides per-channel callbacks.

config I2C_MANAGER_BUS_A_MUX_INT_GPIO
    int "Bus A mux INT GPIO" if I2C_MANAGER_BUS_A_MUX_INT_ENABLE
    default 0
    range 0 SOC_GPIO_PIN_COUNT

config I2C_MANAGER_BUS_B_ENABLE
    bool "Enable I2C Bus B (port 1)"
    default n
config I2C_MANAGER_BUS_B_SDA_GPIO
    int "Bus B SDA GPIO" if I2C_MANAGER_BUS_B_ENABLE
    default 0
    range 0 SOC_GPIO_PIN_COUNT
config I2C_MANAGER_BUS_B_SCL_GPIO
    int "Bus B SCL GPIO" if I2C_MANAGER_BUS_B_ENABLE
    default 0
    range 0 SOC_GPIO_PIN_COUNT

choice I2C_MANAGER_BUS_B_MUX
    prompt "Bus B Mux Type" if I2C_MANAGER_BUS_B_ENABLE
    default I2C_MANAGER_BUS_B_MUX_NONE
    config I2C_MANAGER_BUS_B_MUX_NONE
        bool "None"
    config I2C_MANAGER_BUS_B_MUX_TCA9544A
        bool "TCA9544A (4-channel)"
    config I2C_MANAGER_BUS_B_MUX_PCA9548A
        bool "PCA9548A (8-channel)"
endchoice

config I2C_MANAGER_BUS_B_MUX_ADDRESS
    hex "Bus B mux I2C address" if I2C_MANAGER_BUS_B_ENABLE && !I2C_MANAGER_BUS_B_MUX_NONE
    default 0x70
    range 0x03 0x77

config I2C_MANAGER_BUS_B_MUX_INT_ENABLE
    bool "Enable Bus B mux INT pin" if I2C_MANAGER_BUS_B_ENABLE && I2C_MANAGER_BUS_B_MUX_TCA9544A
    default n
    help
        Enable interrupt aggregation support for TCA9544A on Bus B. Provides per-channel callbacks.

config I2C_MANAGER_BUS_B_MUX_INT_GPIO
    int "Bus B mux INT GPIO" if I2C_MANAGER_BUS_B_MUX_INT_ENABLE
    default 0
    range 0 SOC_GPIO_PIN_COUNT

endmenu
```

## Firmware/nut/shared_components/network_manager/Kconfig
```kconfig
menu "Network Manager Configuration"

    config NETWORK_MANAGER_ETHERNET_RETRY_INTERVAL_MS
        int "Ethernet retry interval (ms)"
        default 30000
        range 0 300000
        help
            How often to retry Ethernet connection if it fails.
            Set to 0 to disable automatic retry.
            Default is 30 seconds.

    config NETWORK_MANAGER_PREFER_ETHERNET
        bool "Prefer Ethernet over WiFi when both are available"
        default y
        help
            When both Ethernet and WiFi are connected, use Ethernet
            as the primary connection for outbound traffic.

endmenu
```
